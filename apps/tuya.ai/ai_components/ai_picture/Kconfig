## apps/tuya.ai/ai_components/ai_picture/Kconfig
```kconfig
menuconfig ENABLE_COMP_AI_PICTURE
    bool "enable ai picture"
    select ENABLE_IMAGE_ALBUM
    default n

if(ENABLE_COMP_AI_PICTURE)
    config COMP_AI_PICTURE_ALBUM_NAME
        string "ai picture album name"
        default "ai_picture"

    config COMP_AI_PICTURE_ALBUM_MAX_IMAGE_CNT
        int "the max count of image in album"
        default 10

    config COMP_AI_PICTURE_DEF_OUTPIUT_WIDTH
        int "ai picture output default width"
        default 320

    config COMP_AI_PICTURE_DEF_OUTPIUT_HEIGHT
        int "ai picture output default height"
        default 480
endif
```

## src/peripherals/printer/Kconfig
```kconfig
config ENABLE_PRINTER
    bool "enable printer"
    default n

if (ENABLE_PRINTER)
    config PRINTER_NAME
        string "the name of printer"
        default "printer"

    config PRINTER_STACK_SIZE
        int "printer task stack size"
        default 4096
        range 1024 16384

    config PRINTER_POLL_INTERVAL_MS
        int "printer status poll interval (ms)"
        default 500
        range 100 5000

    config ENABLE_PRINTER_UART
        bool "enable printer uart"
        default y

    config PRINTER_UART_BAUDRATE
        int "printer uart baudrate"
        default 19200
        range 2400 115200
        depends on ENABLE_PRINTER_UART

    config ENABLE_PRINTER_MTP02
        bool "enable MTP02-DXD thermal printer mechanism driver"
        default n

    config PRINTER_MTP02_STROBE_MS
        int "MTP02 thermal head strobe time (ms)"
        default 1
        range 1 10
        depends on ENABLE_PRINTER_MTP02

    config PRINTER_MTP02_MOTOR_STEP_MS
        int "MTP02 motor step interval (ms)"
        default 3
        range 1 10
        depends on ENABLE_PRINTER_MTP02

    config ENABLE_PRINTER_DP48
        bool "enable DP48A ESC/POS UART printer driver"
        default n
endif
```
